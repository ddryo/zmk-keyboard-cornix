## boards/arm/cornix/Kconfig
```kconfig
config BOARD_ENABLE_DCDC
    bool "Enable DCDC mode"
    select SOC_DCDC_NRF52X
    default y
    depends on (BOARD_CORNIX)

config BOARD_CORNIX_CHARGER
    bool "Enable battery charger"
    default y
    depends on (BOARD_CORNIX)
```

## boards/arm/cornix/Kconfig.defconfig
```kconfig
# Electronut Labs Papyr board configuration

# Copyright (c) 2020 The ZMK Contributors
# SPDX-License-Identifier: MIT

if BOARD_CORNIX

config BOARD
    default "cornix"


if USB_DEVICE_STACK

config USB_NRFX
    default y

endif # USB_DEVICE_STACK

config BT_CTLR
    default BT

config BOARD_CORNIX_CHARGER
    default y

endif # BOARD_CORNIX

## Main device (left side)
if BOARD_CORNIX_LEFT || BOARD_CORNIX_DONGLE

config ZMK_KEYBOARD_NAME
	default "Cornix"

config ZMK_USB
	default y 

config ZMK_SPLIT_ROLE_CENTRAL
    default y

config ZMK_SPLIT_BLE_ROLE_CENTRAL
	default y

config ZMK_SPLIT_BLE_CENTRAL_BATTERY_LEVEL_FETCHING
	default y

config ZMK_SPLIT_BLE_CENTRAL_BATTERY_LEVEL_PROXY
	default y

endif # BOARD_CORNIX_LEFT

## Peripheral device (right side)
if BOARD_CORNIX_RIGHT || BOARD_CORNIX_PH_LEFT

config ZMK_SPLIT_ROLE_CENTRAL
    default n

config ZMK_SPLIT_BLE_ROLE_CENTRAL
	default n

config ZMK_USB
    default n

# Add keyboard debouncing
config ZMK_KSCAN_DEBOUNCE_PRESS_MS
    default 5
config ZMK_KSCAN_DEBOUNCE_RELEASE_MS
    default 5

endif # BOARD_CORNIX_RIGHT

# Common options for both sides
if BOARD_CORNIX_LEFT  || BOARD_CORNIX_DONGLE || BOARD_CORNIX_PH_LEFT || BOARD_CORNIX_RIGHT

config ZMK_SPLIT
	default y

config ZMK_BLE
	default y

## disable rgb by default
config WS2812_STRIP
	default n
config ZMK_RGB_UNDERGLOW
	default n
config ZMK_RGB_UNDERGLOW_EXT_POWER
	default n

endif # BOARD_CORNIX_LEFT || BOARD_CORNIX_RIGHT


# vim: set ft=kconfig:
```

## boards/arm/cornix_e73/Kconfig.board
```kconfig
# cornix board configuration

# Copyright (c) 2020 The ZMK Contributors
# SPDX-License-Identifier: MIT

config BOARD_CORNIX_E73
    bool "cornix_e73"
    depends on SOC_NRF52840_QIAA
```

## boards/arm/cornix_e73/Kconfig.defconfig
```kconfig
# Electronut Labs Papyr board configuration

# Copyright (c) 2020 The ZMK Contributors
# SPDX-License-Identifier: MIT

if BOARD_CORNIX_E73

config BOARD
    default "cornix"

if USB_DEVICE_STACK

config USB_NRFX
    default y

endif # USB_DEVICE_STACK

config BT_CTLR
    default BT

if BOARD_CORNIX_E73

config BOARD_CORNIX_CHARGER
    default y

endif # BOARD_CORNIX_E73 

endif # BOARD_CORNIX_E73
```

## boards/shields/cornix/Kconfig.defconfig
```kconfig
# Copyright (c) 2020 The ZMK Contributors
# SPDX-License-Identifier: MIT


## Main device (left side)
if SHIELD_CORNIX_MAIN_LEFT || SHIELD_CORNIX_DONGLE

config ZMK_KEYBOARD_NAME
	default "Cornix"

config ZMK_USB
	default y 

config ZMK_SPLIT_ROLE_CENTRAL
    default y

config ZMK_SPLIT_BLE_ROLE_CENTRAL
	default y

config ZMK_SPLIT_BLE_CENTRAL_BATTERY_LEVEL_FETCHING
	default y

config ZMK_SPLIT_BLE_CENTRAL_BATTERY_LEVEL_PROXY
	default y

endif # SHIELD_CORNIX_LEFT

## Peripheral device (right side)
if SHIELD_CORNIX_RIGHT || SHIELD_CORNIX_PH_LEFT

config ZMK_SPLIT_ROLE_CENTRAL
    default n

config ZMK_SPLIT_BLE_ROLE_CENTRAL
	default n

config ZMK_USB
    default n

if ZMK_BACKLIGHT

config PWM
    default y

config LED_PWM
    default y

endif # ZMK_BACKLIGHT

# Add keyboard debouncing
config ZMK_KSCAN_DEBOUNCE_PRESS_MS
    default 5
config ZMK_KSCAN_DEBOUNCE_RELEASE_MS
    default 5

endif # SHIELD_CORNIX_RIGHT

# Common options for both sides
if SHIELD_CORNIX_MAIN_LEFT  || SHIELD_CORNIX_DONGLE || SHIELD_CORNIX_PH_LEFT || SHIELD_CORNIX_RIGHT

config ZMK_SPLIT
	default y

config ZMK_BLE
	default y

## disable rgb by default
config WS2812_STRIP
	default n
config ZMK_RGB_UNDERGLOW
	default n
config ZMK_RGB_UNDERGLOW_EXT_POWER
	default n

endif # SHIELD_CORNIX_LEFT || SHIELD_CORNIX_RIGHT


#vim: set ft=Kconfig
```

## boards/shields/cornix/Kconfig.shield
```kconfig
# Copyright (c) 2020 The ZMK Contributors
# SPDX-License-Identifier: MIT

config SHIELD_CORNIX_LEFT
	def_bool $(shields_list_contains,cornix_main_left)

config SHIELD_CORNIX_DONGLE
	def_bool $(shields_list_contains,cornix_dongle)
config SHIELD_CORNIX_RIGHT
	def_bool $(shields_list_contains,cornix_right)
config SHIELD_CORNIX_PH_LEFT
	def_bool $(shields_list_contains,cornix_ph_left)
```

## boards/shields/cornix42/Kconfig.defconfig
```kconfig
# Copyright (c) 2020 The ZMK Contributors
# SPDX-License-Identifier: MIT


## Main device (left side)
if SHIELD_CORNIX42_LEFT || SHIELD_CORNIX42_DONGLE

config ZMK_KEYBOARD_NAME
	default "Cornix"

config ZMK_USB
	default y 

config ZMK_SPLIT_ROLE_CENTRAL
    default y

config ZMK_SPLIT_BLE_ROLE_CENTRAL
	default y

config ZMK_SPLIT_BLE_CENTRAL_BATTERY_LEVEL_FETCHING
	default y

config ZMK_SPLIT_BLE_CENTRAL_BATTERY_LEVEL_PROXY
	default y

endif # SHIELD_CORNIX42_LEFT

## Peripheral device (right side)
if SHIELD_CORNIX42_RIGHT || SHIELD_CORNIX42_PH_LEFT

config ZMK_SPLIT_ROLE_CENTRAL
    default n

config ZMK_SPLIT_BLE_ROLE_CENTRAL
	default n

config ZMK_USB
    default n

# Add keyboard debouncing
config ZMK_KSCAN_DEBOUNCE_PRESS_MS
    default 5
config ZMK_KSCAN_DEBOUNCE_RELEASE_MS
    default 5

endif # SHIELD_CORNIX42_RIGHT

# Common options for both sides
if SHIELD_CORNIX42_LEFT  || SHIELD_CORNIX42_DONGLE || SHIELD_CORNIX42_PH_LEFT || SHIELD_CORNIX42_RIGHT

config ZMK_SPLIT
	default y

config ZMK_BLE
	default y

## disable rgb by default
config WS2812_STRIP
	default n
config ZMK_RGB_UNDERGLOW
	default n
config ZMK_RGB_UNDERGLOW_EXT_POWER
	default n

endif # SHIELD_CORNIX42_LEFT || SHIELD_CORNIX42_RIGHT


#vim: set ft=Kconfig
```

## boards/shields/cornix42/Kconfig.shield
```kconfig
# Copyright (c) 2020 The ZMK Contributors
# SPDX-License-Identifier: MIT

config SHIELD_CORNIX42_LEFT
	def_bool $(shields_list_contains,cornix42_left)

config SHIELD_CORNIX42_DONGLE
	def_bool $(shields_list_contains,cornix42_dongle)
config SHIELD_CORNIX42_RIGHT
	def_bool $(shields_list_contains,cornix42_right)
config SHIELD_CORNIX42_PH_LEFT
	def_bool $(shields_list_contains,cornix42_ph_left)
```

## config/west.yml
```yaml
manifest:
  remotes:
    - name: zmkfirmware
      url-base: https://github.com/zmkfirmware
    - name: hitsmaxft
      url-base: https://github.com/hitsmaxft
    - name: urob
      url-base: https://github.com/urob
    - name: janpfischer
      url-base: https://github.com/janpfischer
  projects:
    # NOTE: ZMK v0.3 にピン留め（Zephyr 3.5ベース）
    # main ブランチは Zephyr 4.1 にアップデートされており、HWMv2 への移行が必要
    # 参考: https://zmk.dev/blog/2025/12/09/zephyr-4-1
    - name: zmk
      remote: zmkfirmware
      revision: v0.3
      clone-depth: 1
      import:
        file: app/west.yml
    - name: zmk-helpers
      remote: urob
      revision: main
      clone-depth: 1
    - name: zmk-rgbled-widget
      remote: hitsmaxft
      revision: main
      clone-depth: 1
    - name: zmk-dongle-display
      remote: hitsmaxft
      revision: main
      clone-depth: 1
    - name: zmk-dongle-screen
      remote: janpfischer
      revision: main
      clone-depth: 1
  self:
    path: config
```
